## Kconfig
```kconfig
menu "Chenry's Driver API"
rsource "hello_world/Kconfig"
rsource "mcp3201/Kconfig"
endmenu
```

## drivers/hello-world/Kconfig
```kconfig
config HELLO_WORLD
    bool "custom hello world output"
    depends on SPI
    help
      Enable the hello world output. You'll need SPI for this to work.
```

## dts/bindings/sensor/microchip,mcp3201.yaml
```yaml
description: Microchip MCP3201 Signle Channle 12-Bit ADC.
compatible: "microchip,mcp3201"
include: [sensor-device.yaml, i2c-device.yaml]

properties:
  scale:
    type: int
    default: 1
    description: The scale factor of the data.
```

## hello_world/Kconfig
```kconfig
config HELLO_WORLD
    bool "custom hello world output"
    default y
    help
      Enable the hello world output
```

## mcp3201/Kconfig
```kconfig
config MCP3201
    bool "12-Bit Single Channel ADC"
    depends on SPI
    default y
    help
      Enable driver for MCP3201. This ADC requires SPI to function
```
